/**
 * main.c - Vibration node firmware for STM32F411CEU6 (Black Pill)
 *
 * Sampling strategy:
 * I use TIM2 at 100 Hz to drive sampling rather than a HAL_Delay loop because
 * a delay-based approach accumulates drift: each I2C read takes a variable
 * ~0.2 ms so a 10 ms delay produces an actual period of ~10.2 ms, yielding
 * an effective sample rate of ~98 Hz instead of 100 Hz.  TIM2 fires at an
 * exact hardware-timed period regardless of I2C transaction length, giving
 * a stable 100 Hz timebase that the DFT relies on for accurate frequency
 * calculation (frequency = bin * sample_rate / N).
 *
 * STM32CubeIDE note:
 * The SystemClock_Config, MX_GPIO_Init, MX_I2C1_Init, MX_USART1_UART_Init and
 * MX_TIM2_Init functions are stubs here.  STM32CubeIDE generates the full
 * implementations from the .ioc file.  I keep the stubs so this file
 * compiles standalone and documents the expected peripheral configuration.
 */

#include "main.h"
#include "mpu6050_driver.h"
#include "fft.h"
#include "uart_output.h"
#include <math.h>    /* sqrtf */
#include <string.h>  /* memset */

/* ---------------------------------------------------------------------
 * HAL peripheral handles
 * I declare these at file scope so the MX_*_Init stubs and the timer
 * callback can both access them without passing pointers through every layer.
 * --------------------------------------------------------------------- */
I2C_HandleTypeDef   hi2c1;
UART_HandleTypeDef  huart1;
TIM_HandleTypeDef   htim2;

/* ---------------------------------------------------------------------
 * Sample buffer
 * I store 100 accel-Z samples (1 second at 100 Hz) rather than a circular
 * buffer because the DFT operates on a complete fixed-length window.  The
 * buffer is overwritten each second so memory usage stays constant.
 * --------------------------------------------------------------------- */
static float accel_z_buf[100];

/* I use volatile here because sample_ready is written in the ISR (TIM2
 * callback) and read in the main loop - without volatile the compiler may
 * cache the read in a register and never see the ISR's update. */
volatile uint8_t sample_ready = 0;
static uint8_t   sample_idx   = 0;

/* ---------------------------------------------------------------------
 * Forward declarations for CubeMX-generated init stubs
 * --------------------------------------------------------------------- */
static void SystemClock_Config(void);
static void MX_GPIO_Init(void);
static void MX_I2C1_Init(void);
static void MX_USART1_UART_Init(void);
static void MX_TIM2_Init(void);
static void Error_Handler(void);

/* =====================================================================
 * Timer period elapsed callback - runs at 100 Hz from TIM2 ISR
 * ===================================================================== */
void HAL_TIM_PeriodElapsedCallback(TIM_HandleTypeDef *htim)
{
    if (htim->Instance != TIM2) return;

    MPU6050_Data imu;

    /* I use ReadAccel (6 bytes) rather than ReadAll (14 bytes) in the ISR
     * to keep I2C bus time short and reduce jitter in the 100 Hz timer. */
    if (MPU6050_ReadAccel(&hi2c1, &imu) == HAL_OK)
    {
        accel_z_buf[sample_idx] = imu.accel_z;
        sample_idx++;

        if (sample_idx >= 100U)
        {
            sample_idx  = 0;
            sample_ready = 1;  /* Signal main loop that a full window is ready */
        }
    }
}

/* =====================================================================
 * main
 * ===================================================================== */
int main(void)
{
    /* HAL_Init must be the first call - it configures the SysTick timer
     * for HAL_Delay and initialises the Flash prefetch and instruction cache. */
    HAL_Init();

    SystemClock_Config();  /* Configure PLL for 96 MHz (generated by CubeIDE) */

    MX_GPIO_Init();
    MX_I2C1_Init();
    MX_USART1_UART_Init();
    MX_TIM2_Init();

    /* Initialise MPU6050 - halt in Error_Handler if the sensor is absent or
     * mis-wired, because there is no useful data to transmit without it. */
    if (MPU6050_Init(&hi2c1) != HAL_OK)
    {
        Error_Handler();
    }

    /* Start TIM2 in interrupt mode.  I use Base_Start_IT rather than
     * PWM or OC modes because I only need the period-elapsed interrupt
     * to trigger sampling; no output compare or capture is required. */
    if (HAL_TIM_Base_Start_IT(&htim2) != HAL_OK)
    {
        Error_Handler();
    }

    /* Main loop - processes one 1-second window per iteration */
    while (1)
    {
        /* Spin-wait for the ISR to collect 100 samples.
         * I avoid a WFI/sleep here because the STM32F411 wakes from WFI on
         * any interrupt including SysTick, and managing re-entry correctly
         * adds complexity that is not needed at 100 Hz. */
        if (sample_ready)
        {
            sample_ready = 0;  /* Clear flag before processing to avoid race */

            /* Compute per-axis means across the 100-sample window.
             * I use separate mean variables rather than reusing the buffer
             * so the FFT still operates on the original Z samples. */
            float sum_x = 0.0f, sum_y = 0.0f, sum_z = 0.0f;
            MPU6050_Data frame;

            /* I re-read a single fresh sample for X and Y means because the
             * sample buffer only stores Z (the primary vibration axis).
             * For a multi-axis FFT upgrade, expand the buffer to 3*100 floats. */
            if (MPU6050_ReadAll(&hi2c1, &frame) == HAL_OK)
            {
                sum_x = frame.accel_x;
                sum_y = frame.accel_y;
            }

            for (uint8_t i = 0; i < 100U; i++)
            {
                sum_z += accel_z_buf[i];
            }

            float mean_x = sum_x;            /* Single point for X/Y */
            float mean_y = sum_y;
            float mean_z = sum_z / 100.0f;   /* Mean of the 100-sample Z window */

            /* Vector magnitude: sqrt(x^2 + y^2 + z^2) */
            float magnitude = sqrtf(mean_x * mean_x +
                                    mean_y * mean_y +
                                    mean_z * mean_z);

            /* Compute DFT peak frequency on the Z-axis buffer.
             * I pass FFT_SIZE (128) as the count limit even though the buffer
             * holds 100 samples; FFT_GetPeakFrequency uses the 'count' param
             * so only 100 samples are processed and the result is still valid. */
            float peak_hz = FFT_GetPeakFrequency(accel_z_buf, 100U, 100.0f);

            UART_SendVibrationData(&huart1,
                                   mean_x, mean_y, mean_z,
                                   magnitude, peak_hz);
        }
    }
}

/* =====================================================================
 * Peripheral init stubs
 * STM32CubeIDE generates the full bodies from the .ioc file.
 * I provide empty stubs so this file compiles and documents pin assignments.
 * ===================================================================== */

/**
 * SystemClock_Config - Configure PLL for 96 MHz system clock.
 * CubeIDE .ioc settings: HSE 25 MHz crystal, PLL M=25, N=192, P=2 -> 96 MHz.
 * I use 96 MHz rather than the maximum 100 MHz because it gives whole-number
 * TIM2 prescaler values for exactly 100 Hz (see README.md for ARR calculation).
 */
static void SystemClock_Config(void)
{
    /* Generated by STM32CubeIDE - do not edit manually */
}

/**
 * MX_GPIO_Init - Initialise GPIO (LED on PC13 for heartbeat, etc.)
 */
static void MX_GPIO_Init(void)
{
    /* Generated by STM32CubeIDE */
}

/**
 * MX_I2C1_Init - Configure I2C1 at 400 kHz on PB6 (SCL) and PB7 (SDA).
 * I use 400 kHz (fast mode) rather than 100 kHz so a 14-byte MPU6050 read
 * completes in ~0.4 ms instead of ~1.4 ms, leaving more CPU time per 10 ms
 * TIM2 period.
 */
static void MX_I2C1_Init(void)
{
    /* Generated by STM32CubeIDE */
    hi2c1.Instance = I2C1;
}

/**
 * MX_USART1_UART_Init - Configure USART1 at 115200 baud on PA9 (TX), PA10 (RX).
 * I use 115200 rather than 9600 so the ~60-byte telemetry line transmits in
 * ~5 ms rather than ~60 ms, keeping the main loop responsive.
 */
static void MX_USART1_UART_Init(void)
{
    /* Generated by STM32CubeIDE */
    huart1.Instance = USART1;
}

/**
 * MX_TIM2_Init - Configure TIM2 for 100 Hz period elapsed interrupt.
 *
 * At 96 MHz system clock and TIM2 on APB1 (which runs at 96 MHz when APB1
 * prescaler = 1):
 *   Prescaler (PSC) = 9600 - 1  -> timer clock = 96 MHz / 9600 = 10 000 Hz
 *   Auto-reload (ARR) = 100 - 1 -> period = 10 000 / 100 = 100 Hz
 *
 * I subtract 1 from both because TIM2 counts from 0 to ARR inclusive (ARR+1
 * ticks per period) and from 0 to PSC inclusive (PSC+1 source clocks per
 * timer clock tick).
 */
static void MX_TIM2_Init(void)
{
    /* Generated by STM32CubeIDE */
    htim2.Instance = TIM2;
}

/**
 * Error_Handler - Halt on unrecoverable fault.
 * I disable interrupts and loop forever rather than attempting a soft reset
 * because a reset loop could cause repeated I2C bus lockup if the sensor
 * is absent.
 */
static void Error_Handler(void)
{
    __disable_irq();
    while (1) { /* Halt */ }
}
